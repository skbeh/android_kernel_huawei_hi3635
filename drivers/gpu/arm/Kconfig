## drivers/gpu/arm/Kconfig
```kconfig
config MALI_DEVICE
	bool "mali device"
	help

if ARCH_HI6XXX
source "drivers/gpu/arm/mali4_32/Kconfig"
source "drivers/gpu/arm/mali4_64/Kconfig"
endif

if HISI_3635
source "drivers/gpu/arm/r26p0-01rel0/Kconfig"
endif

if ARCH_HI3630
source "drivers/gpu/arm/r26p0-01rel0/Kconfig"
endif
```
